## config/boards/shields/sofle_bmp/Kconfig.defconfig
```kconfig
# Copyright (c) 2026
# SPDX-License-Identifier: MIT

if SHIELD_SOFLE_BMP_LEFT

config ZMK_KEYBOARD_NAME
    default "Sofle BMP"

config ZMK_SPLIT_ROLE_CENTRAL
    default y

endif

if SHIELD_SOFLE_BMP_LEFT || SHIELD_SOFLE_BMP_RIGHT

config ZMK_SPLIT
    default y

endif
```

## config/boards/shields/sofle_bmp/Kconfig.shield
```kconfig
# Copyright (c) 2020 Ryan Cross
# SPDX-License-Identifier: MIT

config SHIELD_SOFLE_BMP_LEFT
    def_bool $(shields_list_contains,sofle_bmp_left)

config SHIELD_SOFLE_BMP_RIGHT
    def_bool $(shields_list_contains,sofle_bmp_right)
```

## config/west.yml
```yaml
manifest:
  remotes:
    - name: zmkfirmware
      url-base: https://github.com/zmkfirmware
    - name: sekigon-gonnoc
      url-base: https://github.com/sekigon-gonnoc
  projects:
    - name: zmk
      remote: zmkfirmware
      revision: 714bbe30b052b1062e09a102998c1cae9dd9edf6
      import: app/west.yml
    - name: zmk-component-bmp-boost
      remote: sekigon-gonnoc
      revision: master
      import: west.yml
  self:
    path: config
```
